## CMakeLists.txt
```
cmake_minimum_required(VERSION 3.20.0)

find_package(Zephyr REQUIRED HINTS $ENV{ZEPHYR_BASE})
project(cellular_fundamentals)

# NORDIC SDK APP START
target_include_directories(app PRIVATE include)

target_sources(app PRIVATE
	src/app_zbus.c
	src/gnss.c
	src/ltem.c
	src/main.c
)
# NORDIC SDK APP END
```

## prj.conf
```kconfig
# Logging
CONFIG_LOG=y

# Button and LED support
CONFIG_DK_LIBRARY=y

# Newlib
CONFIG_NEWLIB_LIBC=y
CONFIG_NEWLIB_LIBC_FLOAT_PRINTF=y
CONFIG_FPU=y

# Memory
CONFIG_HEAP_MEM_POOL_SIZE=4096
CONFIG_MAIN_STACK_SIZE=4096

# Modem library
CONFIG_NRF_MODEM_LIB=y

# LTE link control
CONFIG_LTE_LINK_CONTROL=y
CONFIG_LTE_NETWORK_MODE_LTE_M_NBIOT_GPS=y

# Zbus
CONFIG_ZBUS=y
CONFIG_ZBUS_CHANNEL_NAME=y
CONFIG_ZBUS_OBSERVER_NAME=y
CONFIG_ZBUS_LOG_LEVEL_INF=y
```

## src/main.c
```c
#include "app_zbus.h"
#include "gnss.h"
#include "ltem.h"

#include <dk_buttons_and_leds.h>
#include <zephyr/kernel.h>
#include <zephyr/logging/log.h>
#include <zephyr/zbus/zbus.h>

LOG_MODULE_REGISTER(app_main, LOG_LEVEL_INF);

ZBUS_SUBSCRIBER_DEFINE(app_fsm_sub, 8);

enum app_state {
	APP_STATE_INIT = 0,
	APP_STATE_WAIT_LTEM,
	APP_STATE_START_GNSS,
	APP_STATE_WAIT_GNSS_FIX,
	APP_STATE_RUNNING,
	APP_STATE_ERROR,
};

static enum app_state current_state = APP_STATE_INIT;

static const char *app_state_name(enum app_state state)
{
	switch (state) {
	case APP_STATE_INIT:
		return "INIT";
	case APP_STATE_WAIT_LTEM:
		return "WAIT_LTEM";
	case APP_STATE_START_GNSS:
		return "START_GNSS";
	case APP_STATE_WAIT_GNSS_FIX:
		return "WAIT_GNSS_FIX";
	case APP_STATE_RUNNING:
		return "RUNNING";
	case APP_STATE_ERROR:
		return "ERROR";
	default:
		return "UNKNOWN";
	}
}

static void set_state(enum app_state next_state)
{
	if (current_state == next_state) {
		return;
	}

	LOG_INF("FSM transition: %s -> %s", 
		app_state_name(current_state),
		app_state_name(next_state));
	current_state = next_state;
}

static void enter_error_state(const char *reason, int err)
{
	LOG_ERR("%s, err: %d", 
		reason, 
		err);
	set_state(APP_STATE_ERROR);
}

static void handle_ltem_status(const struct app_ltem_status *status)
{
	int err;

	switch (status->state) {
	case APP_LTEM_STATE_CONNECTED:
		if (current_state != APP_STATE_WAIT_LTEM) {
			break;
		}

		set_state(APP_STATE_START_GNSS);
		err = gnss_start();
		if (err) {
			enter_error_state("Failed to start GNSS", err);
			return;
		}

		set_state(APP_STATE_WAIT_GNSS_FIX);
		break;

	case APP_LTEM_STATE_ERROR:
		enter_error_state("LTE-M module reported an error", status->err);
		break;

	default:
		LOG_INF("LTE-M status update: %d", 
			status->state);
		break;
	}
}

static void handle_gnss_status(const struct app_gnss_status *status)
{
	switch (status->state) {
	case APP_GNSS_STATE_FIX:
		if (current_state == APP_STATE_WAIT_GNSS_FIX) {
			set_state(APP_STATE_RUNNING);
		}

		LOG_INF("GNSS fix ready: lat=%.06f lon=%.06f satellites=%u",
			status->latitude, 
			status->longitude, 
			status->tracked_satellites);

		if (status->time_to_first_fix_ms >= 0) {
			LOG_INF("First fix acquired in %lld ms",
				(long long)status->time_to_first_fix_ms);
		}
		break;

	case APP_GNSS_STATE_ERROR:
		enter_error_state("GNSS module reported an error", status->err);
		break;

	default:
		LOG_INF("GNSS status update: %d", 
			status->state);
		break;
	}
}

int main(void)
{
	int err;
	const struct zbus_channel *chan;

	if (dk_leds_init() != 0) {
		LOG_WRN("Failed to initialize the LED library");
	}

	set_state(APP_STATE_INIT);

	err = ltem_init();
	if (err) {
		enter_error_state("Failed to initialize LTE-M module", err);
	}

	if (current_state != APP_STATE_ERROR) {
		err = gnss_init();
		if (err) {
			enter_error_state("Failed to initialize GNSS module", err);
		}
	}

	if (current_state != APP_STATE_ERROR) {
		set_state(APP_STATE_WAIT_LTEM);
		err = ltem_connect();
		if (err) {
			enter_error_state("Failed to start LTE-M connection", err);
		}
	}

	while (1) {
		if (current_state == APP_STATE_ERROR) {
			k_sleep(K_FOREVER);
		}

		err = zbus_sub_wait(&app_fsm_sub, &chan, K_FOREVER);
		if (err) {
			LOG_WRN("zbus_sub_wait failed, err: %d", 
				err);
			continue;
		}

		if (chan == &ltem_status_chan) {
			struct app_ltem_status status;

			err = zbus_chan_read(chan, &status, K_MSEC(50));
			if (err) {
				LOG_WRN("Failed to read LTE-M status, err: %d", 
					err);
				continue;
			}

			handle_ltem_status(&status);
			continue;
		}

		if (chan == &gnss_status_chan) {
			struct app_gnss_status status;

			err = zbus_chan_read(chan, &status, K_MSEC(50));
			if (err) {
				LOG_WRN("Failed to read GNSS status, err: %d", 
					err);
				continue;
			}

			handle_gnss_status(&status);
			continue;
		}

		LOG_WRN("Received notification from unexpected channel: %s",
			zbus_chan_name(chan));
	}
}
```

## include/app_zbus.h
```c
/*
 * Shared Zbus channels and message types used by the LTE-M and GNSS modules.
 */

#ifndef APP_ZBUS_H_
#define APP_ZBUS_H_

#include <stdint.h>

#include <zephyr/zbus/zbus.h>

enum app_ltem_state {
	APP_LTEM_STATE_OFF = 0,
	APP_LTEM_STATE_INITIALIZED,
	APP_LTEM_STATE_CONNECTING,
	APP_LTEM_STATE_CONNECTED,
	APP_LTEM_STATE_ERROR,
};

struct app_ltem_status {
	enum app_ltem_state state;
	int err;
};

enum app_gnss_state {
	APP_GNSS_STATE_IDLE = 0,
	APP_GNSS_STATE_INITIALIZED,
	APP_GNSS_STATE_STARTED,
	APP_GNSS_STATE_FIX,
	APP_GNSS_STATE_ERROR,
};

struct app_gnss_status {
	enum app_gnss_state state;
	int err;
	int64_t time_to_first_fix_ms;
	double latitude;
	double longitude;
	uint8_t tracked_satellites;
};

ZBUS_CHAN_DECLARE(ltem_status_chan);
ZBUS_CHAN_DECLARE(gnss_status_chan);

int app_zbus_publish_ltem_status(enum app_ltem_state state, int err);
int app_zbus_publish_gnss_status(enum app_gnss_state state, int err,
				 int64_t time_to_first_fix_ms, double latitude,
				 double longitude, uint8_t tracked_satellites);

#endif /* APP_ZBUS_H_ */
```

## include/gnss.h
```c
/*
 * Minimal GNSS module interface for the Zbus example.
 */

#ifndef GNSS_H_
#define GNSS_H_

int gnss_init(void);
int gnss_start(void);

#endif /* GNSS_H_ */
```

## include/ltem.h
```c
/*
 * Minimal LTE-M module interface for the Zbus example.
 */

#ifndef LTEM_H_
#define LTEM_H_

int ltem_init(void);
int ltem_connect(void);

#endif /* LTEM_H_ */
```

## src/app_zbus.c
```c
#include "app_zbus.h"

#include <zephyr/kernel.h>
#include <zephyr/logging/log.h>

LOG_MODULE_REGISTER(app_zbus, LOG_LEVEL_INF);

ZBUS_CHAN_DEFINE(ltem_status_chan,
		 struct app_ltem_status,
		 NULL,
		 NULL,
		 ZBUS_OBSERVERS(app_fsm_sub),
		 ZBUS_MSG_INIT(.state = APP_LTEM_STATE_OFF, .err = 0));

ZBUS_CHAN_DEFINE(gnss_status_chan,
		 struct app_gnss_status,
		 NULL,
		 NULL,
		 ZBUS_OBSERVERS(app_fsm_sub),
		 ZBUS_MSG_INIT(.state = APP_GNSS_STATE_IDLE,
			       .err = 0,
			       .time_to_first_fix_ms = -1,
			       .latitude = 0.0,
			       .longitude = 0.0,
			       .tracked_satellites = 0));

static int publish_status(const struct zbus_channel *chan, const void *msg)
{
	int err = zbus_chan_pub(chan, msg, K_NO_WAIT);

	if (err) {
		LOG_WRN("Failed to publish %s, err: %d", 
			zbus_chan_name(chan), 
			err);
	}

	return err;
}

int app_zbus_publish_ltem_status(enum app_ltem_state state, int err)
{
	const struct app_ltem_status msg = {
		.state = state,
		.err = err,
	};

	return publish_status(&ltem_status_chan, &msg);
}

int app_zbus_publish_gnss_status(enum app_gnss_state state, int err,
				 int64_t time_to_first_fix_ms, double latitude,
				 double longitude, uint8_t tracked_satellites)
{
	const struct app_gnss_status msg = {
		.state = state,
		.err = err,
		.time_to_first_fix_ms = time_to_first_fix_ms,
		.latitude = latitude,
		.longitude = longitude,
		.tracked_satellites = tracked_satellites,
	};

	return publish_status(&gnss_status_chan, &msg);
}
```

## src/gnss.c
```c
#include "gnss.h"

#include "app_zbus.h"

#include <dk_buttons_and_leds.h>
#include <modem/lte_lc.h>
#include <nrf_modem_gnss.h>
#include <zephyr/kernel.h>
#include <zephyr/logging/log.h>
#include <zephyr/sys/util.h>

LOG_MODULE_REGISTER(gnss, LOG_LEVEL_INF);

static struct nrf_modem_gnss_pvt_data_frame pvt_data;
static int64_t gnss_start_time;
static bool first_fix;

static int publish_error(int err)
{
	(void)app_zbus_publish_gnss_status(APP_GNSS_STATE_ERROR, err, -1, 0.0, 0.0, 0);

	return err;
}

static uint8_t count_tracked_satellites(const struct nrf_modem_gnss_pvt_data_frame *pvt)
{
	uint8_t count = 0;

	for (size_t i = 0; i < ARRAY_SIZE(pvt->sv); ++i) {
		if (pvt->sv[i].signal != 0U) {
			count++;
		}
	}

	return count;
}

static void print_fix_data(const struct nrf_modem_gnss_pvt_data_frame *pvt)
{
	LOG_INF("Latitude: %.06f", 
		pvt->latitude);
	LOG_INF("Longitude: %.06f", 
		pvt->longitude);
	LOG_INF("Altitude: %.01f m", 
		(double)pvt->altitude);
}

static void gnss_event_handler(int event)
{
	int err;

	switch (event) {
	case NRF_MODEM_GNSS_EVT_PVT: {
		uint8_t satellites;
		int64_t ttff_ms = -1;

		err = nrf_modem_gnss_read(&pvt_data, sizeof(pvt_data), NRF_MODEM_GNSS_DATA_PVT);
		if (err) {
			LOG_ERR("nrf_modem_gnss_read failed, err: %d", 
				err);
			(void)publish_error(err);
			return;
		}

		satellites = count_tracked_satellites(&pvt_data);
		LOG_INF("GNSS search active, satellites tracked: %u", 
			satellites);

		if ((pvt_data.flags & NRF_MODEM_GNSS_PVT_FLAG_FIX_VALID) == 0U) {
			return;
		}

		if (!first_fix) {
			ttff_ms = k_uptime_get() - gnss_start_time;
			first_fix = true;
			LOG_INF("Time to first fix: %lld s", 
				(long long)(ttff_ms / 1000));
		}

		print_fix_data(&pvt_data);
		(void)dk_set_led_on(DK_LED1);
		(void)app_zbus_publish_gnss_status(APP_GNSS_STATE_FIX, 0, ttff_ms,
						   pvt_data.latitude, pvt_data.longitude,
						   satellites);
		break;
	}

	case NRF_MODEM_GNSS_EVT_PERIODIC_WAKEUP:
		LOG_INF("GNSS woke up");
		break;

	case NRF_MODEM_GNSS_EVT_SLEEP_AFTER_FIX:
		LOG_INF("GNSS entered sleep after fix");
		break;

	default:
		break;
	}
}

int gnss_init(void)
{
	int err;

	first_fix = false;
	gnss_start_time = 0;

	err = nrf_modem_gnss_event_handler_set(gnss_event_handler);
	if (err) {
		LOG_ERR("nrf_modem_gnss_event_handler_set failed, err: %d", 
			err);
		return publish_error(err);
	}

	err = nrf_modem_gnss_fix_interval_set(CONFIG_GNSS_PERIODIC_INTERVAL);
	if (err) {
		LOG_ERR("nrf_modem_gnss_fix_interval_set failed, err: %d", 
			err);
		return publish_error(err);
	}

	err = nrf_modem_gnss_fix_retry_set(CONFIG_GNSS_PERIODIC_TIMEOUT);
	if (err) {
		LOG_ERR("nrf_modem_gnss_fix_retry_set failed, err: %d", 
			err);
		return publish_error(err);
	}

	(void)app_zbus_publish_gnss_status(APP_GNSS_STATE_INITIALIZED, 0, -1, 0.0, 0.0, 0);
	return 0;
}

int gnss_start(void)
{
	int err;

	err = lte_lc_func_mode_set(LTE_LC_FUNC_MODE_NORMAL);
	if (err) {
		LOG_ERR("lte_lc_func_mode_set failed, err: %d", 
			err);
		return publish_error(err);
	}

	LOG_INF("Starting GNSS");
	err = nrf_modem_gnss_start();
	if (err) {
		LOG_ERR("nrf_modem_gnss_start failed, err: %d", 
			err);
		return publish_error(err);
	}

	gnss_start_time = k_uptime_get();
	(void)app_zbus_publish_gnss_status(APP_GNSS_STATE_STARTED, 0, -1, 0.0, 0.0, 0);
	return 0;
}
```

## src/ltem.c
```c
#include "ltem.h"

#include "app_zbus.h"

#include <dk_buttons_and_leds.h>
#include <modem/lte_lc.h>
#include <modem/nrf_modem_lib.h>
#include <zephyr/logging/log.h>

LOG_MODULE_REGISTER(ltem, LOG_LEVEL_INF);

static int publish_error(int err)
{
	(void)app_zbus_publish_ltem_status(APP_LTEM_STATE_ERROR, err);

	return err;
}

static void lte_handler(const struct lte_lc_evt *const evt)
{
	switch (evt->type) {
	case LTE_LC_EVT_NW_REG_STATUS:
		if ((evt->nw_reg_status != LTE_LC_NW_REG_REGISTERED_HOME) &&
		    (evt->nw_reg_status != LTE_LC_NW_REG_REGISTERED_ROAMING)) {
			break;
		}

		LOG_INF("LTE-M connected to %s network",
			evt->nw_reg_status == LTE_LC_NW_REG_REGISTERED_HOME ?
				"home" :
				"roaming");
		(void)dk_set_led_on(DK_LED2);
		(void)app_zbus_publish_ltem_status(APP_LTEM_STATE_CONNECTED, 0);
		break;

	case LTE_LC_EVT_RRC_UPDATE:
		LOG_INF("RRC mode: %s",
			evt->rrc_mode == LTE_LC_RRC_MODE_CONNECTED ? "connected" : "idle");
		break;

	default:
		break;
	}
}

int ltem_init(void)
{
	int err;

	LOG_INF("Initializing modem library");
	err = nrf_modem_lib_init();
	if (err) {
		LOG_ERR("nrf_modem_lib_init failed, err: %d", 
			err);
		return publish_error(err);
	}

	err = lte_lc_system_mode_set(LTE_LC_SYSTEM_MODE_LTEM_GPS,
				     LTE_LC_SYSTEM_MODE_PREFER_AUTO);
	if (err) {
		LOG_ERR("lte_lc_system_mode_set failed, err: %d", 
			err);
		return publish_error(err);
	}

	err = lte_lc_func_mode_set(LTE_LC_FUNC_MODE_NORMAL);
	if (err) {
		LOG_ERR("lte_lc_func_mode_set failed, err: %d", 
			err);
		return publish_error(err);
	}

	(void)app_zbus_publish_ltem_status(APP_LTEM_STATE_INITIALIZED, 0);
	return 0;
}

int ltem_connect(void)
{
	int err;

	LOG_INF("Starting LTE-M connection");
	(void)app_zbus_publish_ltem_status(APP_LTEM_STATE_CONNECTING, 0);

	err = lte_lc_connect_async(lte_handler);
	if (err) {
		LOG_ERR("lte_lc_connect_async failed, err: %d", 
			err);
		return publish_error(err);
	}

	return 0;
}
```
