## CMakeLists.txt
```
#
# Copyright (c) 2019 Nordic Semiconductor
#
# SPDX-License-Identifier: LicenseRef-Nordic-5-Clause
#

cmake_minimum_required(VERSION 3.20.0)

find_package(Zephyr REQUIRED HINTS $ENV{ZEPHYR_BASE})
project(AGNSS)

zephyr_library_sources(src/main.c)

zephyr_library_sources_ifdef(CONFIG_GNSS_SAMPLE_ASSISTANCE_NRF_CLOUD src/assistance.c)
zephyr_library_sources_ifdef(CONFIG_GNSS_SAMPLE_ASSISTANCE_SUPL src/assistance_supl.c)
zephyr_library_sources_ifdef(CONFIG_GNSS_SAMPLE_ASSISTANCE_MINIMAL src/assistance_minimal.c)
zephyr_library_sources_ifdef(CONFIG_GNSS_SAMPLE_ASSISTANCE_MINIMAL src/mcc_location_table.c)
```

## Kconfig
```
menu "nRF Cloud CoAP Cellular Location Sample"

config COAP_CELL_DEFAULT_DOREPLY_VAL
	bool "Default value for the do_reply configuration flag"
	default y

config COAP_CELL_DEFAULT_FALLBACK_VAL
	bool "Default value for the fallback configuration flag"
	default y

config COAP_CELL_DEFAULT_HICONF_VAL
	bool "Default value for the hi_conf configuration flag"

module = NRF_CLOUD_COAP_CELL_LOCATION_SAMPLE
module-str = nRF Cloud CoAP Cellular Location Sample
source "$(ZEPHYR_BASE)/subsys/logging/Kconfig.template.log_config"

endmenu

menu "Zephyr Kernel"
source "Kconfig.zephyr"
endmenu
```

## prj.conf
```kconfig
#
# Copyright (c) 2019 Nordic Semiconductor ASA
#
# SPDX-License-Identifier: LicenseRef-Nordic-5-Clause
#

# General
CONFIG_FPU=y
CONFIG_NRF_MODEM_LIB=y
CONFIG_STDOUT_CONSOLE=y
CONFIG_UART_INTERRUPT_DRIVEN=y
CONFIG_PICOLIBC_IO_FLOAT=y
CONFIG_LOG=y
CONFIG_LOG_MODE_IMMEDIATE=y

# GNSS sample
# Enable to use nRF Cloud A-GNSS
CONFIG_NRF_CLOUD=y
CONFIG_GNSS_SAMPLE_ASSISTANCE_NRF_CLOUD=n

# LTE Link Control
CONFIG_LTE_LINK_CONTROL=y
CONFIG_LTE_LC_PSM_MODULE=y
CONFIG_LTE_PSM_REQ=y
# PSM requested periodic TAU 8 hours
CONFIG_LTE_PSM_REQ_RPTAU="00101000"
# PSM requested active time 6 seconds
CONFIG_LTE_PSM_REQ_RAT="00000011"

# AT Host library - Used to send AT commands directy from an UART terminal and to allow
#		    integration with nRF Connect for Desktop LTE Link monitor application.
CONFIG_AT_HOST_LIBRARY=y

# Networking
CONFIG_NETWORKING=y
CONFIG_NET_SOCKETS_OFFLOAD=y
CONFIG_NET_SOCKETS=y
# Disable native network stack to save some memory
CONFIG_NET_NATIVE=n

# Memory and stack configuration
CONFIG_HEAP_MEM_POOL_SIZE=2048
CONFIG_MAIN_STACK_SIZE=4096
CONFIG_SYSTEM_WORKQUEUE_STACK_SIZE=1536

# Eanbling logging
CONFIG_LOG=y
CONFIG_LOG_DEFAULT_LEVEL=3
CONFIG_LOG_MODE_IMMEDIATE=y
```

## src/main.c
```c
/*
 * Copyright (c) 2025 Nordic Semiconductor ASA
 *
 * SPDX-License-Identifier: LicenseRef-Nordic-5-Clause
 */

#include <string.h>
#include <zephyr/kernel.h>
#include <nrf_modem_at.h>
#include <modem/lte_lc.h>
#include <modem/location.h>
#include <modem/nrf_modem_lib.h>
#include <modem/modem_battery.h>
#include <date_time.h>
#include <zephyr/logging/log.h>
#include <net/nrf_cloud_coap.h>
#include <app_version.h>
#include <zephyr/smf.h>

LOG_MODULE_REGISTER(app, LOG_LEVEL_INF);

static void print_location(double latitude, double longitude, uint32_t accuracy);
static void handle_cloud_location_request(const struct lte_lc_cells_info *cell_info);

// 1. Define States 
enum app_state {
	STATE_BOOT, 
	STATE_WAIT_LTE,
	STATE_WAIT_TIME,
	STATE_LOCATION_INIT,
	STATE_COAP_INIT,
	STATE_COAP_CONNECT,
	STATE_LOCATION_REQUEST,
	STATE_WAIT_LOCATION,
	STATE_BATTERY_SAMPLE,
	STATE_BATTERY_SEND, 
	STATE_DONE,
	STATE_ERROR,
};


// 2. Define event types 
enum app_evt_type {
	EVT_NONE,
	EVT_LTE_CONNECTED,
	EVT_TIME_READY,
	EVT_LOCATION_READY,
	EVT_LOCATION_TIMEOUT,
	EVT_LOCATION_ERROR,
	EVT_CLOUD_LOC_READY,
	EVT_CLOUD_LOC_ERROR,

	EVT_BATTERY_SAMPLE_READY,
	EVT_BATTERY_SEND_DONE,
	EVT_BATTERY_SEND_ERROR,
	EVT_BATTERY_LOW,
};

// 3. Define SMF context object
struct app_ctx {
	struct smf_ctx ctx; 

	enum app_evt_type evt; 
	bool lte_connected; 
	int err; 

	struct nrf_cloud_location_config config;	

	double lat; 
	double lon; 
	uint32_t unc; 

	//Battery 
	int battery_mv;
	int battery_pct; 
	bool battery_low; 
}; 


// 4. Global app object - structure to hold configuration flags. 
static struct app_ctx app = {
	.config = {
		.hi_conf = IS_ENABLED(CONFIG_COAP_CELL_DEFAULT_HICONF_VAL),
		.fallback = IS_ENABLED(CONFIG_COAP_CELL_DEFAULT_FALLBACK_VAL),
		.do_reply = IS_ENABLED(CONFIG_COAP_CELL_DEFAULT_DOREPLY_VAL),
	},
};

// 5. SMF Events

/* Date/time Event - decide when date/time is ready */

static void date_time_evt_handler(const struct date_time_evt *evt)
{
	ARG_UNUSED(evt); 
	app.evt = EVT_TIME_READY; 
}

/* LTE Event - decide when lte is connected*/
static void lte_event_handler(const struct lte_lc_evt *const evt)
{
		if (evt->type == LTE_LC_EVT_NW_REG_STATUS){
			if ((evt->nw_reg_status == LTE_LC_NW_REG_REGISTERED_HOME) ||
				(evt->nw_reg_status == LTE_LC_NW_REG_REGISTERED_ROAMING)) {
				LOG_INF("Connected to network");
				app.lte_connected = true;
		}
	}
}

/* Location Event - */
static void location_event_handler(const struct location_event_data *event_data)
{
	switch (event_data->id) {
	case LOCATION_EVT_LOCATION:
		LOG_INF("Got location from location library");
		app.lat = (double)event_data->location.latitude;
		app.lon = (double)event_data->location.longitude; 
		app.unc = (uint32_t)event_data->location.accuracy;
		app.evt = EVT_LOCATION_READY;
		break;

	case LOCATION_EVT_TIMEOUT:
		LOG_DBG("Getting location timed out");
		app.evt = EVT_LOCATION_TIMEOUT;
		break;

	case LOCATION_EVT_ERROR:
		LOG_DBG("Getting location failed");
		app.evt = EVT_LOCATION_ERROR;
		break;

	case LOCATION_EVT_GNSS_ASSISTANCE_REQUEST:
		LOG_DBG("Getting location assistance requested (A-GNSS)");
		break;

	case LOCATION_EVT_GNSS_PREDICTION_REQUEST:
		LOG_DBG("Getting location assistance requested (P-GPS)");
		break;

	case LOCATION_EVT_CLOUD_LOCATION_EXT_REQUEST:
		LOG_DBG("Cloud location request received from location library");
		handle_cloud_location_request(event_data->cloud_location_request.cell_data);
		break;

	default:
		LOG_ERR("Getting location: Unknown event");
		app.evt = EVT_LOCATION_ERROR;
		break;
	}
}



// 6. Define state function prototypes 
static void boot_entry(void *obj);
static enum smf_state_result boot_run(void *obj);



static void wait_lte_entry(void *obj);
static enum smf_state_result wait_lte_run(void *obj);

static void wait_time_entry(void *obj);
static enum smf_state_result wait_time_run(void *obj);

static void location_init_entry(void *obj);
static enum smf_state_result location_init_run(void *obj);

static void coap_init_entry(void *obj);
static enum smf_state_result coap_init_run(void *obj);

static void coap_connect_entry(void *obj);
static enum smf_state_result coap_connect_run(void *obj);

static void location_request_entry(void *obj);
static enum smf_state_result location_request_run(void *obj);

static enum smf_state_result wait_location_run(void *obj);

static void battery_sample_entry(void *obj);
static enum smf_state_result battery_sample_run(void *obj);

static void battery_send_entry(void *obj);
static enum smf_state_result battery_send_run(void *obj);

static void done_entry(void *obj);
static void error_entry(void *obj);


// 7. State table 
static const struct smf_state app_states[] = {
	[STATE_BOOT]             = SMF_CREATE_STATE(boot_entry, boot_run, NULL, NULL, NULL),
	[STATE_WAIT_LTE]         = SMF_CREATE_STATE(wait_lte_entry, wait_lte_run, NULL, NULL, NULL),
	[STATE_WAIT_TIME]        = SMF_CREATE_STATE(wait_time_entry, wait_time_run, NULL, NULL, NULL),
	[STATE_LOCATION_INIT]    = SMF_CREATE_STATE(location_init_entry, location_init_run, NULL, NULL, NULL),
	[STATE_COAP_INIT]        = SMF_CREATE_STATE(coap_init_entry, coap_init_run, NULL, NULL, NULL),
	[STATE_COAP_CONNECT]     = SMF_CREATE_STATE(coap_connect_entry, coap_connect_run, NULL, NULL, NULL),
	[STATE_LOCATION_REQUEST] = SMF_CREATE_STATE(location_request_entry, location_request_run, NULL, NULL, NULL),
	[STATE_WAIT_LOCATION]    = SMF_CREATE_STATE(NULL, wait_location_run, NULL, NULL, NULL),
	[STATE_BATTERY_SAMPLE]   = SMF_CREATE_STATE(battery_sample_entry, battery_sample_run, NULL, NULL, NULL),
	[STATE_BATTERY_SEND]     = SMF_CREATE_STATE(battery_send_entry, battery_send_run, NULL, NULL, NULL),
	[STATE_DONE]             = SMF_CREATE_STATE(done_entry, NULL, NULL, NULL, NULL),
	[STATE_ERROR]            = SMF_CREATE_STATE(error_entry, NULL, NULL, NULL, NULL),
};


// 8. BOOT
static void boot_entry(void *obj)
{
	struct app_ctx *ctx = obj;

	LOG_INF("nRF Cloud CoAP Cellular Location Sample, version: %s",
		APP_VERSION_STRING);

	ctx->evt = EVT_NONE;
	ctx->err = nrf_modem_lib_init();
	if (ctx->err) {
		LOG_ERR("Modem library initialization failed, error: %d", ctx->err);
		return;
	}

	if (IS_ENABLED(CONFIG_DATE_TIME)) {
		date_time_register_handler(date_time_evt_handler);
	}

	lte_lc_register_handler(lte_event_handler);
}

static enum smf_state_result boot_run(void *obj)
{
	struct app_ctx *ctx = obj;

	if (ctx->err) {
		smf_set_state(SMF_CTX(ctx), &app_states[STATE_ERROR]);
	} else {
		smf_set_state(SMF_CTX(ctx), &app_states[STATE_WAIT_LTE]);
	}

	return SMF_EVENT_HANDLED;
}

// 9. WAIT_LTE
static void wait_lte_entry(void *obj)
{
	struct app_ctx *ctx = obj;
	
	LOG_INF("Connecting to LTE...");
	ctx->evt = EVT_NONE;
	ctx->err = lte_lc_connect();
	if (ctx->err) {
		LOG_ERR("lte_lc_connect failed: %d", ctx->err);
	}
}
static enum smf_state_result wait_lte_run(void *obj)
{
	struct app_ctx *ctx = obj;

	//Debug 
	LOG_INF("wait_lte_run: err=%d evt%d lte=%d", ctx->err, ctx->evt, ctx->lte_connected);

	if (ctx->err) {
		smf_set_state(SMF_CTX(ctx), &app_states[STATE_ERROR]);
		return SMF_EVENT_HANDLED;
	}

		if (ctx->lte_connected) {

		ctx->lte_connected = false;

		if (IS_ENABLED(CONFIG_DATE_TIME)) {

			LOG_INF("Transitioning to STATE_WAIT_TIME");

			smf_set_state(SMF_CTX(ctx), &app_states[STATE_WAIT_TIME]);
		} else {

			LOG_INF("Transitioning to STATE_LOCATION_INIT");

			smf_set_state(SMF_CTX(ctx), &app_states[STATE_LOCATION_INIT]);
		}
	}

	return SMF_EVENT_HANDLED;
}

// 10. WAIT_TIME
static void wait_time_entry(void *obj)
{
	struct app_ctx *ctx = obj;
	ARG_UNUSED(ctx);

	// Debug
	LOG_INF("Entered STATE_WAIT_TIME");

	LOG_INF("Waiting for current time");
}

static enum smf_state_result wait_time_run(void *obj)
{
	struct app_ctx *ctx = obj;

	if (ctx->evt == EVT_TIME_READY) {
		ctx->evt = EVT_NONE;

		if (!date_time_is_valid()) {
			LOG_ERR("Failed to get current time. Continuing anyway.");
		}

		smf_set_state(SMF_CTX(ctx), &app_states[STATE_LOCATION_INIT]);
	}

	return SMF_EVENT_HANDLED;
}

// 11. LOCATION INIT
static void location_init_entry(void *obj)
{
	struct app_ctx *ctx = obj;

	ctx->err = location_init(location_event_handler);
	if (ctx->err) {
		LOG_ERR("Initializing the Location library failed, error: %d", ctx->err);
	}
}

static enum smf_state_result location_init_run(void *obj)
{
	struct app_ctx *ctx = obj;

	if (ctx->err) {
		smf_set_state(SMF_CTX(ctx), &app_states[STATE_ERROR]);
	} else {
		smf_set_state(SMF_CTX(ctx), &app_states[STATE_COAP_INIT]);
	}

	return SMF_EVENT_HANDLED;
}


// 12. COAP INIT & COAP CONNECT
static void coap_init_entry(void *obj)
{
	struct app_ctx *ctx = obj;

	//Debug
	LOG_INF("Entered STATE_COAP_INIT");

	ctx->err = nrf_cloud_coap_init();
	if (ctx->err) {
		LOG_ERR("Failed to initialize CoAP client: %d", ctx->err);
	}
}

static enum smf_state_result coap_init_run(void *obj)
{
	struct app_ctx *ctx = obj;

	if (ctx->err) {
		smf_set_state(SMF_CTX(ctx), &app_states[STATE_ERROR]);
	} else {
		smf_set_state(SMF_CTX(ctx), &app_states[STATE_COAP_CONNECT]);
	}

	return SMF_EVENT_HANDLED;
}

static void coap_connect_entry(void *obj)
{
	struct app_ctx *ctx = obj;

	ctx->err = nrf_cloud_coap_connect(NULL);
	if (ctx->err) {
		LOG_ERR("Connecting to nRF Cloud failed, error: %d", ctx->err);
	}
}

static enum smf_state_result coap_connect_run(void *obj)
{
	struct app_ctx *ctx = obj;

	if (ctx->err) {
		smf_set_state(SMF_CTX(ctx), &app_states[STATE_ERROR]);
	} else {
		smf_set_state(SMF_CTX(ctx), &app_states[STATE_LOCATION_REQUEST]);
	}

	return SMF_EVENT_HANDLED;
}


// 13. LOCATION REQUEST

static void location_request_entry(void *obj)
{
	struct app_ctx *ctx = obj;

	//Debug
	LOG_INF("Entered STATE_LOCATION_REQUEST");

	LOG_INF("Requesting location with the default configuration...");

	ctx->evt = EVT_NONE;
	ctx->err = location_request(NULL);
	if (ctx->err) {
		LOG_ERR("Requesting location failed, error: %d", ctx->err);
	}
}

static enum smf_state_result location_request_run(void *obj)
{
	struct app_ctx *ctx = obj;

	if (ctx->err) {
		smf_set_state(SMF_CTX(ctx), &app_states[STATE_ERROR]);
	} else {
		smf_set_state(SMF_CTX(ctx), &app_states[STATE_WAIT_LOCATION]);
	}

	return SMF_EVENT_HANDLED;
}

// 14. WAIT LOCATION
static enum smf_state_result wait_location_run(void *obj)
{
	struct app_ctx *ctx = obj;

	switch (ctx->evt) {
	case EVT_LOCATION_READY:
		ctx->evt = EVT_NONE;
		smf_set_state(SMF_CTX(ctx), &app_states[STATE_BATTERY_SAMPLE]);
		break;

	case EVT_LOCATION_TIMEOUT:
		ctx->evt = EVT_NONE;
		ctx->err = -ETIMEDOUT;
		smf_set_state(SMF_CTX(ctx), &app_states[STATE_ERROR]);
		break;

	case EVT_LOCATION_ERROR:
	case EVT_CLOUD_LOC_ERROR:
		ctx->evt = EVT_NONE;
		if (ctx->err == 0) {
			ctx->err = -EIO;
		}
		smf_set_state(SMF_CTX(ctx), &app_states[STATE_ERROR]);
		break;

	default:
		break;
	}

	return SMF_EVENT_HANDLED;
}

// 15. DONE & ERROR
static void done_entry(void *obj)
{
	struct app_ctx *ctx = obj;

	print_location(ctx->lat, ctx->lon, ctx->unc);

	LOG_INF("Waiting %d seconds before next report", CONFIG_REPORT_INTERVAL_SECONDS);

	k_sleep(K_SECONDS(CONFIG_REPORT_INTERVAL_SECONDS));

	smf_set_state(SMF_CTX(ctx), &app_states[STATE_LOCATION_REQUEST]);
}

static void error_entry(void *obj)
{
	struct app_ctx *ctx = obj;

	LOG_ERR("Application failed, err=%d", ctx->err);
	smf_set_terminate(SMF_CTX(ctx), ctx->err ? ctx->err : -1);
}

// 16. Battery 
static int battery_sample(struct app_ctx *ctx)
{
	int err; 

	if (ctx == NULL) {
		return -EINVAL;
	}

	// Get Modem Voltage
	err = modem_battery_voltage_get(&ctx->battery_mv);

	if (err){
		LOG_ERR("Battery voltage read failed, err: %d", err);
		return err;
	}

	LOG_INF("Battery sampled: %d mV", ctx->battery_mv);

	return 0;
}

static int cloud_send_battery(const struct app_ctx *ctx)
{
	int err; 
	char msg[100];
	
	if (ctx == NULL) {
		return -EINVAL;
	}

	snprintk(msg, sizeof(msg),
		 "{\"appId\":\"BATTERY\",\"messageType\":\"DATA\",\"data\":%d}",
		 ctx->battery_mv);


	err = nrf_cloud_coap_json_message_send(msg,false,true);
	if (err){
		LOG_ERR("Failed to send battery data: %d", err); 
		return err; 
	}

	LOG_INF("Battery voltage sent: %d mV", ctx->battery_mv);
	
	return 0;
}


static void battery_sample_entry(void *obj)
{
	struct app_ctx *ctx = obj;

	// Debug
	LOG_INF("ENtered STATE_BATTERY_SAMPLE");

	ctx->err = battery_sample(ctx);
	if (ctx->err) {
		LOG_ERR("Battery sample failed: %d", ctx->err);
		return;
	}
}


static enum smf_state_result battery_sample_run(void *obj)
{
	struct app_ctx *ctx = obj;

	if (ctx->err) {
		smf_set_state(SMF_CTX(ctx), &app_states[STATE_ERROR]);
	} else {
		smf_set_state(SMF_CTX(ctx), &app_states[STATE_BATTERY_SEND]);
	}

	return SMF_EVENT_HANDLED;
}

static void battery_send_entry(void *obj)
{
	struct app_ctx *ctx = obj;

	//DEBUG
	LOG_INF("ENTERED STATE_BATTERY_SEND");

	ctx->err = cloud_send_battery(ctx);
	if (ctx->err) {
		LOG_ERR("Battery send failed: %d", ctx->err);
	}
}

static enum smf_state_result battery_send_run(void *obj)
{
	struct app_ctx *ctx = obj;

	if (ctx->err) {
		smf_set_state(SMF_CTX(ctx), &app_states[STATE_ERROR]);
	} else {
		smf_set_state(SMF_CTX(ctx), &app_states[STATE_DONE]);
	}

	return SMF_EVENT_HANDLED;
}

// Printing Location to nRF Cloud

static void print_location(double latitude, double longitude, uint32_t accuracy)
{
	LOG_INF("Lat: %f, Lon: %f, Uncertainty: %u m", latitude, longitude, accuracy);
	LOG_INF("Google maps URL: https://maps.google.com/?q=%.06f,%.06f",
		latitude, longitude);
}


// Cloud location request
static void handle_cloud_location_request(const struct lte_lc_cells_info *cell_info)
{
	int err = 0;
	struct nrf_cloud_location_result cell_pos_result = {0};
	struct location_data loc = {0};

	const struct nrf_cloud_rest_location_request cell_pos_req = {
		.config = &app.config,
		.cell_info = (struct lte_lc_cells_info *)cell_info,
	};

	err = nrf_cloud_coap_location_get(&cell_pos_req, &cell_pos_result);
	if (err) {
		LOG_ERR("Request failed, error: %d", err);
		if (cell_pos_result.err != NRF_CLOUD_ERROR_NONE) {
			LOG_ERR("nRF Cloud error code: %d", cell_pos_result.err);
		}
		app.err = err;
		app.evt = EVT_CLOUD_LOC_ERROR;
		return;
	}

	LOG_INF("Cellular location request fulfilled with %s",
		cell_pos_result.type == LOCATION_TYPE_SINGLE_CELL ? "single-cell" :
		cell_pos_result.type == LOCATION_TYPE_MULTI_CELL ? "multi-cell" :
		"unknown");


	// Local copy for logs 
	app.lat = cell_pos_result.lat;
	app.lon = cell_pos_result.lon;
	app.unc = cell_pos_result.unc;
	

	// Pass the external result back to the location library
	loc.latitude = cell_pos_result.lat; 
	loc.longitude = cell_pos_result.lon;
	loc.accuracy = cell_pos_result.unc; 

	location_cloud_location_ext_result_set(LOCATION_EXT_RESULT_SUCCESS,&loc);
	
	/*
	if (err){
		LOG_ERR("Failed to provide external location result to library: %d", err);
		app.err = err;
		app.evt = EVT_CLOUD_LOC_ERROR;
		return;
	}
	*/

}

int main(void)
{
	int ret;

	smf_set_initial(SMF_CTX(&app), &app_states[STATE_BOOT]);

	while (1) {
		ret = smf_run_state(SMF_CTX(&app));
		if (ret) {
			return ret;
		}

		k_sleep(K_MSEC(100));
	}
}
```
