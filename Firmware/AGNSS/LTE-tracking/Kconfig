## Firmware/AGNSS/LTE-tracking/Kconfig
```kconfig
menu "nRF Cloud CoAP Cellular Location Sample"

config COAP_CELL_DEFAULT_DOREPLY_VAL
	bool "Default value for the do_reply configuration flag"
	default y

config COAP_CELL_DEFAULT_FALLBACK_VAL
	bool "Default value for the fallback configuration flag"
	default y

config COAP_CELL_DEFAULT_HICONF_VAL
	bool "Default value for the hi_conf configuration flag"
	default y

config REPORT_INTERVAL_SECONDS
	int "Report interval in seconds"
	default 60
	range 1 86400
	help
	  Interval in seconds between each location and battery report
	  sent to nRF Cloud.

module = NRF_CLOUD_COAP_CELL_LOCATION_SAMPLE
module-str = nRF Cloud CoAP Cellular Location Sample
source "$(ZEPHYR_BASE)/subsys/logging/Kconfig.template.log_config"

endmenu

menu "Zephyr Kernel"
source "Kconfig.zephyr"
endmenu
```

## tests/modules/gnss_service/testcase.yaml
```yaml
common:
  tags:
    - gnss
    - unit
  type: unit
tests:
  app.gnss_service.logic:
    platform_allow:
      - unit_testing
    integration_platforms:
      - unit_testing
```

## tests/modules/lte_service/testcase.yaml
```yaml
common:
  tags:
    - lte
    - unit
  type: unit
tests:
  app.lte_service.logic:
    platform_allow:
      - unit_testing
    integration_platforms:
      - unit_testing
```

## tests/modules/modem_service/testcase.yaml
```yaml
common:
  tags:
    - modem
    - unit
  type: unit
tests:
  app.modem_service.logic:
    platform_allow:
      - unit_testing
    integration_platforms:
      - unit_testing
```

## tests/modules/ntn_service/testcase.yaml
```yaml
common:
  tags:
    - ntn
    - unit
  type: unit
tests:
  app.ntn_service.logic:
    platform_allow:
      - unit_testing
    integration_platforms:
      - unit_testing
```

## tests/modules/rsrp_service/testcase.yaml
```yaml
common:
  tags:
    - rsrp
    - unit
  type: unit
tests:
  app.rsrp_service.logic:
    platform_allow:
      - unit_testing
    integration_platforms:
      - unit_testing
```

## tests/modules/sensors_service/testcase.yaml
```yaml
common:
  tags:
    - sensors
    - unit
  type: unit
tests:
  app.sensors_service.logic:
    platform_allow:
      - unit_testing
    integration_platforms:
      - unit_testing
```

## twister-out/unit_testing_unit_testing/host/IES2608/tests/modules/gnss_service/app.gnss_service.logic/Kconfig/Kconfig.shield.defconfig
```kconfig
osource "C:/Users/golde/Documents/NTNU/ncs/v3.2.4/zephyr/subsys/testsuite/boards/shields/*/Kconfig.defconfig"
osource "C:/Users/golde/Documents/NTNU/ncs/v3.2.4/nrf/boards/shields/*/Kconfig.defconfig"
```

## twister-out/unit_testing_unit_testing/host/IES2608/tests/modules/gnss_service/app.gnss_service.logic/Kconfig/boards/Kconfig.unit_testing
```kconfig
# Load board Kconfig descriptions.
osource "C:/Users/golde/Documents/NTNU/ncs/v3.2.4/zephyr/subsys/testsuite/boards/unit_testing/unit_testing/Kconfig.unit_testing"
```

## twister-out/unit_testing_unit_testing/host/IES2608/tests/modules/lte_service/app.lte_service.logic/Kconfig/arch/Kconfig
```kconfig
# Load Zephyr Arch Kconfig descriptions.
osource "C:/Users/golde/Documents/NTNU/ncs/v3.2.4/zephyr/arch/rx/Kconfig"
osource "C:/Users/golde/Documents/NTNU/ncs/v3.2.4/zephyr/arch/x86/Kconfig"
osource "C:/Users/golde/Documents/NTNU/ncs/v3.2.4/zephyr/arch/xtensa/Kconfig"
osource "C:/Users/golde/Documents/NTNU/ncs/v3.2.4/zephyr/arch/sparc/Kconfig"
osource "C:/Users/golde/Documents/NTNU/ncs/v3.2.4/zephyr/arch/riscv/Kconfig"
osource "C:/Users/golde/Documents/NTNU/ncs/v3.2.4/zephyr/arch/posix/Kconfig"
osource "C:/Users/golde/Documents/NTNU/ncs/v3.2.4/zephyr/arch/mips/Kconfig"
osource "C:/Users/golde/Documents/NTNU/ncs/v3.2.4/zephyr/arch/arm64/Kconfig"
osource "C:/Users/golde/Documents/NTNU/ncs/v3.2.4/zephyr/arch/arm/Kconfig"
osource "C:/Users/golde/Documents/NTNU/ncs/v3.2.4/zephyr/arch/arc/Kconfig"
osource "C:/Users/golde/Documents/NTNU/ncs/v3.2.4/zephyr/subsys/testsuite/arch/unit_testing/Kconfig"
```

## twister-out/unit_testing_unit_testing/host/IES2608/tests/modules/lte_service/app.lte_service.logic/Kconfig/boards/Kconfig
```kconfig
# Load Zephyr board Kconfig descriptions.
osource "C:/Users/golde/Documents/NTNU/ncs/v3.2.4/zephyr/subsys/testsuite/boards/unit_testing/unit_testing/Kconfig"
```

## twister-out/unit_testing_unit_testing/host/IES2608/tests/modules/sensors_service/app.sensors_service.logic/Kconfig/Kconfig.shield
```kconfig
osource "C:/Users/golde/Documents/NTNU/ncs/v3.2.4/zephyr/subsys/testsuite/boards/shields/*/Kconfig.shield"
osource "C:/Users/golde/Documents/NTNU/ncs/v3.2.4/nrf/boards/shields/*/Kconfig.shield"
```

## twister-out/unit_testing_unit_testing/host/IES2608/tests/modules/sensors_service/app.sensors_service.logic/Kconfig/boards/Kconfig.defconfig
```kconfig
# Load Zephyr board defconfig descriptions.
osource "C:/Users/golde/Documents/NTNU/ncs/v3.2.4/zephyr/subsys/testsuite/boards/unit_testing/unit_testing/Kconfig.defconfig"
```

## west.yml
```yaml
manifest:
  version: 0.13

  remotes:
    - name: zephyrproject
      url-base: https://github.com/zephyrproject-rtos
    - name: nordicsemi
      url-base: https://github.com/nrfconnect

  projects:
    - name: zephyr
      remote: zephyrproject
      revision: v4.1.0
      import:
        path-prefix: deps

  self:
    path: IES2608-NordicSemiconductor
```
